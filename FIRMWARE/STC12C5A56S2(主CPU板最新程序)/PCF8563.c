#include "STC12C5A56S2.H" //单片机头文件
#include <intrins.h>      //51单片机的汇编语句的C语言调用接口
#include "PCF8563.H"      //时钟芯片头文

sbit SCL_8563 = P3^4;     //串行时钟
sbit SDA_8563 = P3^5;     //串行数据


/*********************************************************/
/*函数名:I2C_Start()                                     */
/*函数功能:起始条件                                      */
/*入口参数:无                                            */
/*返回值:无                                              */
/*********************************************************/
void I2C_Start(void) 
{        
  EA = 0;

  SDA_8563=1; //数据线置高

  SCL_8563=1; //时钟线置高
  _nop_();
  _nop_();
            
  SDA_8563=0; //数据线置低    
  _nop_();
  _nop_();
                     
  SCL_8563=0; 
}


/*********************************************************/
/*函数:I2C_Stop()                                        */
/*功能:产生I2C总线的停止状态                             */
/*入口参数:无                                            */
/*返回值:无                                              */
/*说明:
  SCL处于高电平期间,当SDA出现上升沿时停止I2C总线
  不论SDA和SCL处于什么电平状态,本函数总能正确产生停止状态
  本函数执行后,I2C总线处于空闲状态                       */
/*********************************************************/
void I2C_Stop(void)
{   
  SDA_8563=0; //数据线置低
  _nop_();
  _nop_();
                   
  SCL_8563=1; //时钟线置高
  _nop_();
  _nop_();
                  
  SDA_8563=1; //数据线置高
  _nop_();
  _nop_();

  //SCL_8563=0; 
  //_nop_();
  //_nop_(); 

  EA = 1;      
}



/*********************************************************/
/*函数:Wait_ACK()                                        */
/*功能:主接收器在接收从传送器传送的每个字节后产生一个标志位
       ,在标志位时钟脉冲出现时,SDA应保持低电平           */
/*入口参数:无                                            */
/*返回值:无                                              */
/*********************************************************/
void Wait_ACK(void)
{   
  unsigned char errtime=20;

  SDA_8563=1; //数据线置高
  _nop_();
  _nop_();
       
  SCL_8563=1; //时钟线置高
  _nop_();
  _nop_();

  while(SDA_8563)
  {  
    errtime--;
    if(!errtime) //如果没有等到,则结束传输
	{
	  I2C_Stop();
	}
  }

  SCL_8563=0; 
  _nop_();
  _nop_();
}


/*********************************************************/ 
/*函数名:Write_Byte()                                    */
/*函数功能:发送数据                                      */
/*入口参数:wData                                         */    
/*返回值:无                                              */
/*********************************************************/
void Write_Byte(unsigned char wdata)
{  
  unsigned char i;

  for(i=0;i<8;i++)
  { 
    if(wdata & 0x80) 
	  SDA_8563 = 1; 
    else 
	  SDA_8563 = 0;

    wdata <<= 1;

    SCL_8563=1;
    _nop_();
    _nop_();
          
    SCL_8563=0;
  }
  Wait_ACK();
}




/*********************************************************/
/*函数:WriteData()                                       */
/*功能:向特定的地址写数据                                */
/*入口参数:地址和数据                                    */
/*返回值:无                                              */
/*********************************************************/
void WriteData(unsigned char address,unsigned char mdata)
{
  I2C_Start();
  Write_Byte(0xa2); 
  Write_Byte(address);
  Write_Byte(mdata);          
  I2C_Stop();
}




/*********************************************************/
/*函数:START_8563()                                      */
/*功能:以分钟的方式启动定时器                            */
/*入口参数:无                                            */
/*返回值:无                                              */
/*********************************************************/
void START_8563(void)
{
  WriteData(0x0,0x20);    //停止定时器
  WriteData(0x0e,0x83);   //TE=1,Td1=1,Td0=1
  
  //WriteData(0x0f,0x05); //记数器的记数初值
  WriteData(0x0f,0x0a);   //记数器的记数初值
  WriteData(0x1,0x01);    
  WriteData(0x0,0x00);    
}


/*********************************************************/
/*函数:S10_START_8563()                                  */
/*功能:将定时器的定时方式改为秒                          */
/*入口参数:时间参数                                      */
/*返回值:无                                              */
/*********************************************************/
void S10_START_8563(unsigned char count)
{
  WriteData(0x0,0x20);   //停止定时器
  WriteData(0x0e,0x82);
  WriteData(0x0f,count); //记数器的记数初值
  WriteData(0x1,0x01);  
  WriteData(0x0,0x00);   
}


/*********************************************************/
/*函数:stop_sys()                                        */
/*功能:停止定时器                                        */
/*入口参数:无                                            */
/*返回值:无                                              */
/*********************************************************/
void stop_sys(void)
{
  WriteData(0x0,0x20);
}


/*********************************************************/
/*函数:start_sys()                                       */
/*功能:启动定时器                                        */
/*入口参数:无                                            */
/*返回值:无                                              */
/*********************************************************/
void start_sys(void)
{
  WriteData(0x0,0x00);
}
